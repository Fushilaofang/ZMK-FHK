## boards/fushilaofang/fhk/board.yml
```yaml
boards:
  - name: fhk_left
    vendor: Fushilaofang
    socs:
      - name: nrf52840
  - name: fhk_right
    vendor: Fushilaofang
    socs:
      - name: nrf52840
```

## config/west.yml
```yaml
manifest:
  remotes:
    - name: petejohanson
      url-base: https://github.com/petejohanson
    - name: Fu
      url-base: https://github.com/Fushilaofang 
  projects:
    - name: ZMK-FHK
      url: https://github.com/Fushilaofang/ZMK-FHK
      revision: master
    - name: zmk
      remote: petejohanson
      revision: core/move-to-zephyr-4-1
      import: app/west.yml
  self:
    path: config
```
