## boards/arm/fhk/Kconfig.board
```kconfig
#
# Copyright (c) 2024 The ZMK Contributors
# SPDX-License-Identifier: MIT
#

config BOARD_FHK_LEFT
    bool "fhk left"
    depends on SOC_NRF52840_QIAA

config BOARD_FHK_RIGHT
    bool "fhk right"
    depends on SOC_NRF52840_QIAA
```

## boards/arm/fhk/Kconfig.defconfig
```kconfig
#
# Copyright (c) 2024 The ZMK Contributors
# SPDX-License-Identifier: MIT
#

if BOARD_FHK_LEFT

config ZMK_KEYBOARD_NAME
    default "FHK36-P"

config ZMK_SPLIT_ROLE_CENTRAL
    default y

endif # BOARD_FHK_LEFT

if BOARD_FHK_LEFT || BOARD_FHK_RIGHT

config BOARD
    default "fhk"

config ZMK_SLEEP
    default y

config ZMK_SPLIT
    default y

config BT_CTLR
    default BT

if USB

config USB_NRFX
    default y

config USB_DEVICE_STACK
    default y

endif # USB

endif # BOARD_FHK_LEFT || BOARD_FHK_RIGHT
```

## boards/fushilaofang/fhk/Kconfig.fhk_right
```kconfig
#
# Copyright (c) 2022 Darryl deHaan
# SPDX-License-Identifier: MIT
#

config BOARD_FHK_RIGHT
    select SOC_NRF52840_QIAA
    imply RETAINED_MEM
    imply RETENTION
    imply RETENTION_BOOT_MODE
```
